/*
 * at91sam9g20isis.dts - Device Tree file for Kubos Linux on ISIS iOBC board (at91sam9g20isis)
 *
 * Copyright (C) 2017 Kubos Corporation
 *
 * Licensed under GPLv2.
 * 
 * Author: Catherine Garabedian <catherine@kubos.co>
 *
 */
/dts-v1/;
#include "iobc-common.dtsi"
#include "iobc.dtsi"
