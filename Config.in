## package/cubeos/Config.in
```kconfig
menuconfig BR2_PACKAGE_CUBEOS
	bool "Cube-OS Packages"
	default y
	help
		Enable Cube-OS services and libraries

if BR2_PACKAGE_CUBEOS
	
	config BR2_CUBEOS_VERSION
		string "Cube-OS Source Version"
		default "master"
		help
			Release, tag, or branch of the Cube-OS repo to use when building Cube-OS
			packages

    
    # source "$BR2_EXTERNAL_CUBEOS_LINUX_PATH/package/cubeos/cubeos-core/Config.in"
    # source "$BR2_EXTERNAL_CUBEOS_LINUX_PATH/package/cubeos/cubeos-monitor/Config.in"
    # source "$BR2_EXTERNAL_CUBEOS_LINUX_PATH/package/cubeos/cubeos-app-api/Config.in"
    # source "$BR2_EXTERNAL_CUBEOS_LINUX_PATH/package/cubeos/cubeos-hal-i2c/Config.in"
    # source "$BR2_EXTERNAL_CUBEOS_LINUX_PATH/package/cubeos/cubeos-service-lib/Config.in"
    
    # source "$BR2_EXTERNAL_CUBEOS_LINUX_PATH/package/cubeos/cubeos-clyde-3g-eps/Config.in"
    # source "$BR2_EXTERNAL_CUBEOS_LINUX_PATH/package/cubeos/cubeos-isis-ants/Config.in"  	
    # source "$BR2_EXTERNAL_CUBEOS_LINUX_PATH/package/cubeos/cubeos-mai400/Config.in"
    # source "$BR2_EXTERNAL_CUBEOS_LINUX_PATH/package/cubeos/cubeos-novatel-oem6/Config.in"
    # source "$BR2_EXTERNAL_CUBEOS_LINUX_PATH/package/cubeos/cubeos-nsl-duplex/Config.in"
    # source "$BR2_EXTERNAL_CUBEOS_LINUX_PATH/package/cubeos/cubeos-pumpkin-mcu/Config.in"
    # source "$BR2_EXTERNAL_CUBEOS_LINUX_PATH/package/cubeos/cubeos-pumpkin-mcu-api/Config.in"
    # source "$BR2_EXTERNAL_CUBEOS_LINUX_PATH/package/cubeos/cubeos-pumpkin-wdt/Config.in"
    # source "$BR2_EXTERNAL_CUBEOS_LINUX_PATH/package/cubeos/cubeos-set-sd/Config.in"
    # source "$BR2_EXTERNAL_CUBEOS_LINUX_PATH/package/cubeos/cubeos-get-sd/Config.in"

endif
```

## package/cubeos/cubeos-core/Config.in
```kconfig
menuconfig BR2_PACKAGE_CUBEOS_CORE
   bool "Cube-OS Core Services"
   default y
   select BR2_PACKAGE_CUBEOS_CORE_APP_SERVICE
   select BR2_PACKAGE_CUBEOS_CORE_FILE_TRANSFER
   select BR2_PACKAGE_CUBEOS_CORE_SHELL
   select BR2_PACKAGE_CUBEOS_CORE_TELEMETRY_DB
   help
       Include the KubOS core services

if BR2_PACKAGE_CUBEOS_CORE
    source "$BR2_EXTERNAL_CUBEOS_LINUX_PATH/package/cubeos/cubeos-core/cubeos-core-app-service/Config.in"
    source "$BR2_EXTERNAL_CUBEOS_LINUX_PATH/package/cubeos/cubeos-core/cubeos-core-file-transfer/Config.in"
    source "$BR2_EXTERNAL_CUBEOS_LINUX_PATH/package/cubeos/cubeos-core/cubeos-core-scheduler/Config.in"
    source "$BR2_EXTERNAL_CUBEOS_LINUX_PATH/package/cubeos/cubeos-core/cubeos-core-shell/Config.in"
    source "$BR2_EXTERNAL_CUBEOS_LINUX_PATH/package/cubeos/cubeos-core/cubeos-core-telemetry-db/Config.in"
endif
```

## package/cubeos/cubeos-get-sd/Config.in
```kconfig
config BR2_PACKAGE_CUBEOS_GET_SD
	bool
	default y
	depends on BR2_CUBEOS_SD_SWITCH
```

## package/cubeos/cubeos-monitor/Config.in
```kconfig
menuconfig BR2_PACKAGE_CUBEOS_MONITOR
    bool "Monitor Service"
    default y
    select BR2_PACKAGE_HAS_CUBEOS_MONITOR
    help
        Include Cube-OS monitor service.
        
        This service provides the ability to query the OBC's current processes and memory usage

if BR2_PACKAGE_CUBEOS_MONITOR

config BR2_CUBEOS_MONITOR_INIT_LVL
    int "Monitor Service Init Level"
    default 90
    range 10 99
    depends on BR2_PACKAGE_CUBEOS_MONITOR
    help
        The initialization priority level of the Cube-OS service.
        The lower the number, the earlier the service is initialized.

config BR2_CUBEOS_MONITOR_RESTART_COUNT
    int "Service Restart Limit"
    default 3
    depends on BR2_PACKAGE_CUBEOS_MONITOR
    depends on BR2_PACKAGE_MONIT
    help
        The maximum number of times the service should be restarted within the timeframe
        specified by BR2_CUBEOS_MONITOR_RESTART_CYCLES if it goes down

config BR2_CUBEOS_MONITOR_RESTART_CYCLES
    int "Service Restart Limit Timeframe"
    default 10
    depends on BR2_PACKAGE_CUBEOS_MONITOR
    depends on BR2_PACKAGE_MONIT
    help
        The number of Monit monitoring cycles in which the maximum number of service restarts
        must occur before the system stops trying to recover the service.
        
        The resulting maximum timeframe in which the restarts must occur can be calculated by
        multiplying this number by the length of a single Monit sleep cycle (60 seconds)
            
config BR2_CUBEOS_MONITOR_IP
    string "Service IP Address"
    default "0.0.0.0"
    depends on BR2_PACKAGE_CUBEOS_MONITOR
    help
        The IP address which the service should use to receive GraphQL requests
        
config BR2_CUBEOS_MONITOR_PORT
    int "Service Port"
    default 8030
    depends on BR2_PACKAGE_CUBEOS_MONITOR
    help
        The port which the service should use to receive GraphQL requests  
        
endif

config BR2_PACKAGE_HAS_CUBEOS_MONITOR
    bool

config BR2_PACKAGE_PROVIDES_CUBEOS_MONITOR
    string
    default "cubeos"
```

## package/cubeos/cubeos-pumpkin-mcu-api/Config.in
```kconfig
config BR2_PACKAGE_CUBEOS_PUMPKIN_MCU_API
    bool "Pumpkin MCU Python API"
    default n
    depends on BR2_PACKAGE_PYTHON3
    select BR2_PACKAGE_CUBEOS_HAL_I2C
    help
        Include the Pumpkin MCU API for Python.
```

## package/cubeos/cubeos-service-lib/Config.in
```kconfig
config BR2_PACKAGE_CUBEOS_SERVICE_LIB
    bool "Cube-OS Service Python Library"
    default n
    depends on BR2_PACKAGE_PYTHON3
    select BR2_PACKAGE_PYTHON_FLASK_GRAPHQL
    select BR2_PACKAGE_PYTHON_GRAPHENE
    select BR2_PACKAGE_PYTHON_TOML
    help
        Include the Cube-OS service library for Python.
        
        This library simplifies the process of writing servives.
        It should be included if you intend to use services which are written in Python.
```

## package/cubeos/cubeos-set-sd/Config.in
```kconfig
config BR2_PACKAGE_CUBEOS_SET_SD
	bool
	default y
	depends on BR2_CUBEOS_SD_SWITCH
```

## package/kubos/kubos-app-api/Config.in
```kconfig
config BR2_PACKAGE_CUBEOS_APP_API
    bool "Python App API"
    default y
    depends on BR2_PACKAGE_PYTHON3
    select BR2_PACKAGE_PYTHON_TOML
    select BR2_PACKAGE_PYTHON_REQUESTS
    help
        Include the Cube-OS app API for Python.
        
        This API simplifies the process of communicating with Cube-OS services.
        It should be included if you intend to write mission applications using Python.
```
